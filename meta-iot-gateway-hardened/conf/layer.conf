## meta-iot-gateway-hardened/conf/layer.conf
```bitbake
# We have a conf and classes directory, add to BBPATH
BBPATH .= ":${LAYERDIR}"

# We have recipes-* directories, add to BBFILES
BBFILES += "${LAYERDIR}/recipes-*/*/*.bb \
            ${LAYERDIR}/recipes-*/*/*.bbappend"

BBFILE_COLLECTIONS += "meta-iot-gateway-hardened"
BBFILE_PATTERN_meta-iot-gateway-hardened = "^${LAYERDIR}/"
BBFILE_PRIORITY_meta-iot-gateway-hardened = "10"

LAYERDEPENDS_meta-iot-gateway-hardened = "core openembedded-layer networking-layer security"
LAYERSERIES_COMPAT_meta-iot-gateway-hardened = "scarthgap"
```
